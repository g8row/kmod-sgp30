/dts-v1/;
/plugin/;
/ {
	compatible = "brcm,bcm2835";
	fragment@0 {
		target = <&i2c1>;
		__overlay__ {
			#address-cells = <1>;
			#size-cells = <0>;

			sgp30: sgp30@58 {
				compatible = "sgp30";
				reg = <0x58>;
				status = "okay";
			};
		};
	};
};
